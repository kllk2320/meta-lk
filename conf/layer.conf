## conf/layer.conf
```bitbake
# We have a conf and classes directory, add to BBPATH
BBPATH .= ":${LAYERDIR}"

# We have a packages directory, add to BBFILES
BBFILES += " \
		${LAYERDIR}/recipes-*/*/*.bb \
		${LAYERDIR}/recipes-*/*/*.bbappend"

BBFILE_COLLECTIONS += "lk"
BBFILE_PRIORITY_lk = "5"
BBFILE_PATTERN_lk := "^${LAYERDIR}/"

LAYERDEPENDS_lk += "petalinux"
```
